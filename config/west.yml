## config/west.yml
```yaml
manifest:
  remotes:
    - name: zmkfirmware
      url-base: https://github.com/zmkfirmware
    - name: carrefinho
      url-base: https://github.com/carrefinho
  projects:
    - name: zmk
      remote: zmkfirmware
      revision: 930b5cc0
      import: app/west.yml
    - name: prospector-zmk-module
      remote: carrefinho
      revision: core/zephyr-4-1
  self:
    path: config
```
